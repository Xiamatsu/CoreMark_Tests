# N32G430_DFP register map
Vendor: NSING; File version: 1.1.0
NSING N32G430 Series Device Support and Example
Registers are 32-bit, read-write, reset 0x0 unless marked. A register's access mark holds for its fields unless they carry their own. Offsets are from the block's base; lines under a group give offsets from that group; [hi:lo] are bit positions; {n}, {i} and the like mark numbered series; 'fields as' and 'values as' point back to an identical list; <NAME> marks a mode.

## Memory map
0x40000000 TIM2 size 0x400 — General purpose timer
0x40000400 TIM3 size 0x400 — General purpose timer
0x40000800 TIM4 size 0x400 — General purpose timer
0x40000C00 TIM5 size 0x400 — General purpose timer
0x40001000 TIM6 size 0x400 — Basic timer
0x40002400 COMP size 0x400 — comparator
0x40002800 RTC size 0x400 — Real time clock
0x40002C00 WWDG size 0x400 — window watchdog
0x40003000 IWDG size 0x400 — Independent watchdog
0x40004400 USART2 size 0x400
0x40004C00 LPTIM size 0x400 — Low power timer control
0x40005400 I2C1 size 0x400 — Inter integrated circuit
0x40005800 I2C2 size 0x400
0x40006400 CAN size 0x400 — Controller area network
0x40007000 PWR size 0x400 — Power control
0x40010000 AFIO size 0x400 — Alternate function I/O
0x40010400 EXTI size 0x20 — external interrupt/event controller
0x40010800 BEEPER size 0x400 — Beeper unit
0x40012C00 TIM1 size 0x400 — Advanced timer
0x40013000 SPI1 size 0x400 — Serial peripheral interface
0x40013400 TIM8 size 0x400 — Advanced timer
0x40013800 USART1 size 0x400 — Universal synchronous asynchronous receiver transmitter
0x40013C00 SPI2 size 0x400 — Serial peripheral interface
0x40015000 UART3 size 0x400 — Universal asynchronous receiver transmitter
0x40015400 UART4 size 0x400
0x40020000 DMA size 0x400 — Direct memory access controller
0x40020800 ADC size 0x400 — analog to digital converter
0x40021000 RCC size 0x40 — Reset and clock control
0x40022000 FLASH size 0x38 — interal FLASH controller
0x40023000 CRC size 0x20 — cyclic redundancy check
0x40023400 GPIOA size 0x400 — General purpose I/O
0x40023800 GPIOB size 0x400
0x40023C00 GPIOC size 0x400
0x40024000 GPIOD size 0x400
0xE0042000 DBG size 0x400 — debug support for MCU

## Interrupts
0 WWDG — WWDG interrupt
1 PVD (PWR) — PVD through EXTI line detection interrupt
2 RTC_TAMPER_STAMP (RTC) — RTC Tamper interrupt or Timestamp through EXTI line 18
3 RTC_WKUP (RTC) — RTC wakeup timer through EXTI line 19 interrupt
4 FLASH — FLASH interrupt
5 RCC — RCC interrupt
6 EXTI0 (EXTI) — EXTI0 interrupt
7 EXTI1 (EXTI) — EXTI1 interrupt
8 EXTI2 (EXTI) — EXTI2 interrupt
9 EXTI3 (EXTI) — EXTI3 interrupt
10 EXTI4 (EXTI) — EXTI4 interrupt
{n+10} DMA_Channel{n} (DMA) (n=1..8) — DMA channel{n} global interrupt
19 ADC — ADC global interrupt
21 COMP — COMP1/2 global interrupt through EXTI line 21/22/23
22 EXTI9_5 (EXTI) — EXTI5/6/7/8/9 interrupt
23 TIM1_BRK (TIM1) — TIM1 Break interrupt
24 TIM1_UP (TIM1) — TIM1 Update interrupt
25 TIM1_TRG_COM (TIM1) — TIM1 Trigger and Commutation interrupts
26 TIM1_CC (TIM1) — TIM1 Capture Compare interrupt
27 TIM2 — TIM2 global interrupt
28 TIM3 — TIM3 global interrupt
29 TIM4 — TIM4 global interrupt
30 I2C1_EV (I2C1) — I2C1 Event interrupt
31 I2C1_ER (I2C1) — I2C1 Error interrupt
32 I2C2_EV (I2C2) — I2C2 Event interrupt
33 I2C2_ER (I2C2) — I2C2 Error interrupt
34 SPI1 — SPI1 global interrupt
35 SPI2 — SPI2 global interrupt
36 USART1 — USART1 global interrupt
37 USART2 — USART2 global interrupt
38 UART3 — UART3 global interrupt
39 EXTI15_10 (EXTI) — EXTI10/11/12/13/14/15 interrupt
40 RTC_Alarm (RTC) — RTC Alarm through EXTI Line 17 Interrupt
41 LPTIM_WKUP (LPTIM) — LPTIMER wakeup interrupt through EXTI line 20
42 TIM8_BRK (TIM8) — TIM8 Break interrupt
43 TIM8_UP (TIM8) — TIM8 Update interrupt
44 TIM8_TRG_COM (TIM8) — TIM8 Trigger and Commutation interrupts
45 TIM8_CC (TIM8) — TIM8 Capture Compare interrupt
46 UART4 — UART4 global interrupt
47 TIM5 — TIM5 global interrupt
48 TIM6 — TIM6 global interrupt
49 CAN_TX (CAN) — CAN TX interrupts
50 CAN_RX0 (CAN) — CAN RX0 interrupts
51 CAN_RX1 (CAN) — CAN RX1 interrupts
52 CAN_SCE (CAN) — CAN SCE interrupt
